## embedded/buildroot-extree/configs/licheepi_nano_defconfig
```kconfig
BR2_arm=y
BR2_arm926t=y
BR2_ARM_INSTRUCTIONS_ARM=y
BR2_TOOLCHAIN_BUILDROOT_VENDOR="f1c100s"

BR2_REPRODUCIBLE=y
BR2_PER_PACKAGE_DIRECTORIES=y

BR2_TOOLCHAIN_BUILDROOT_MUSL=y
BR2_PACKAGE_HOST_GDB=y
BR2_PACKAGE_HOST_GDB_SIM=y
BR2_PACKAGE_HOST_GDB_PYTHON3=y

BR2_CCACHE=y
BR2_ENABLE_DEBUG=y
BR2_DEBUG_3=y
BR2_OPTIMIZE_FAST=y
BR2_ENABLE_LTO=y

BR2_LINUX_KERNEL=y
BR2_LINUX_KERNEL_CUSTOM_GIT=y
BR2_LINUX_KERNEL_CUSTOM_REPO_URL="https://git.kernel.org/pub/scm/linux/kernel/git/torvalds/linux.git"
BR2_LINUX_KERNEL_CUSTOM_REPO_VERSION="946c6b59c56dc6e7d8364a8959cb36bf6d10bc37"
BR2_LINUX_KERNEL_PATCH="$(BR2_EXTERNAL_HUI_PATH)/patches/aw-f1c100s/linux/"
BR2_LINUX_KERNEL_DEFCONFIG="allwinner_f1c100s"
BR2_LINUX_KERNEL_ZIMAGE=y
BR2_LINUX_KERNEL_LZMA=y

BR2_PACKAGE_BUSYBOX_WATCHDOG=y
BR2_PACKAGE_VMTOUCH=y
BR2_PACKAGE_GDB=y
BR2_PACKAGE_GDB_SERVER=y
BR2_PACKAGE_LRZSZ=y
BR2_PACKAGE_EK=y
BR2_PACKAGE_PPPD=y
# BR2_PACKAGE_PPPD_OVERWRITE_RESOLV_CONF is not set
BR2_PACKAGE_SOCAT=y
BR2_PACKAGE_TCPDUMP=y
BR2_PACKAGE_TMUX=y
BR2_PACKAGE_PINENTRY=y
BR2_PACKAGE_GNUPG2=y
BR2_PACKAGE_FILE=y

BR2_ROOTFS_POST_IMAGE_SCRIPT="support/scripts/genimage.sh"
BR2_ROOTFS_POST_SCRIPT_ARGS="-c $(BR2_EXTERNAL_HUI_PATH)/board/f1c100s/genimage.cfg"
BR2_TARGET_ROOTFS_CPIO=y
BR2_TARGET_ROOTFS_CPIO_LZMA=y
BR2_TARGET_ROOTFS_INITRAMFS=y

BR2_TARGET_UBOOT=y
BR2_TARGET_UBOOT_BUILD_SYSTEM_KCONFIG=y
BR2_TARGET_UBOOT_CUSTOM_GIT=y
BR2_TARGET_UBOOT_CUSTOM_REPO_URL="https://source.denx.de/u-boot/u-boot"
BR2_TARGET_UBOOT_CUSTOM_REPO_VERSION="5dcfc99b2b17fa1497adea47a50bf7c7a6ba5709"
BR2_TARGET_UBOOT_PATCH="$(BR2_EXTERNAL_HUI_PATH)/patches/aw-f1c100s/uboot/"
BR2_TARGET_UBOOT_BOARD_DEFCONFIG="licheepi_nano"
# BR2_TARGET_UBOOT_FORMAT_BIN is not set
BR2_TARGET_UBOOT_FORMAT_CUSTOM=y
BR2_TARGET_UBOOT_FORMAT_CUSTOM_NAME="u-boot-sunxi-with-spl.bin"
BR2_TARGET_UBOOT_NEEDS_DTC=y
BR2_TARGET_UBOOT_NEEDS_PYTHON3=y
BR2_TARGET_UBOOT_NEEDS_PYLIBFDT=y
BR2_TARGET_UBOOT_NEEDS_OPENSSL=y

BR2_PACKAGE_HOST_GENIMAGE=y
BR2_PACKAGE_HOST_SWIG=y
BR2_PACKAGE_HOST_SUNXI_TOOLS=y
BR2_PACKAGE_HOST_UBOOT_TOOLS=y
```

## embedded/buildroot-extree/package/ek/Config.in
```kconfig
config BR2_PACKAGE_EK
	bool "ek"
	help
	  Compact, fast, robust, portable Kermit file transfer
	  source code to embed in devices.

	  https://kermitproject.org/ek.html
```
